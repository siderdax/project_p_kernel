/*
 * Samsung's Exynos5430 SoC pin-mux and pin-config device tree source
 *
 * Copyright (c) 2013 Samsung Electronics Co., Ltd.
 *		http://www.samsung.com
 *
 * Samsung's Exynos5430 SoC pin-mux and pin-config options are listed as device
 * tree nodes are listed in this file.
 *
 * This program is free software; you can redistribute it and/or modify
 * it under the terms of the GNU General Public License version 2 as
 * published by the Free Software Foundation.
*/

#include "mv7420-pinctrl-codegen.h"
#include "exynos7420-pinctrl-def.h"

&hdmi_hdmi_hpd_pinctrl {
		hdmi_hdmi_hpd: hdmi_hdmi_hpd {
			samsung,pins = hdmi_hdmi_hpd_pin;
			samsung,pin-function = <hdmi_hdmi_hpd_con>;
			samsung,pin-pud = <hdmi_hdmi_hpd_pull>;
			samsung,pin-drv = <hdmi_hdmi_hpd_drv>;
		};
};

&hdmi_ext_hpd_pinctrl {
		hdmi_ext_hpd: hdmi_ext_hpd {
			samsung,pins = hdmi_ext_hpd_pin;
			samsung,pin-function = <hdmi_ext_hpd_con>;
			samsung,pin-pud = <hdmi_ext_hpd_pull>;
			samsung,pin-drv = <hdmi_ext_hpd_drv>;
		};
};		

&hdmi_cec_pinctrl {
		hdmi_cec: hdmi_cec {
			samsung,pins = hdmi_cec_pin;
			samsung,pin-function = <hdmi_cec_con>;
			samsung,pin-pud = <hdmi_cec_pull>;
			samsung,pin-drv = <hdmi_cec_drv>;
		};
};

#if defined(CONFIG_DTS_BT_BCM4339)||defined(CONFIG_DTS_BT_BCM4358)
&cfg_hostwake_pinctrl {		
		cfg_hostwake: cfg-hostwake {
			samsung,pins = cfg_hostwake_pin;
			samsung,pin-function = <cfg_hostwake_con>;
			samsung,pin-pud = <cfg_hostwake_pull>;
			samsung,pin-con-pdn = <cfg_hostwake_con_pdn>;
			samsung,pin-pud-pdn = <cfg_hostwake_pull_pdn>;
		};
};

&cfg_btwake_pinctrl {
		cfg_btwake: cfg-btwake {
			samsung,pins = cfg_btwake_pin;
			samsung,pin-function = <cfg_btwake_con>;
			samsung,pin-pud = <cfg_btwake_pull>;
			samsung,pin-con-pdn = <cfg_btwake_con_pdn>;
			samsung,pin-pud-pdn = <cfg_btwake_pull_pdn>;
		};
};

&cfg_en_pinctrl {		
		cfg_en: cfg-en {
			samsung,pins =cfg_en_pin;
			samsung,pin-function = <cfg_en_con>;
			samsung,pin-pud = <cfg_en_pull>;
			samsung,pin-con-pdn = <cfg_en_con_pdn>;
			samsung,pin-pud-pdn = <cfg_en_pull_pdn>;
		};
};
#endif

#if defined(CONFIG_DTS_WIFI_BCM4339)||defined(CONFIG_DTS_WIFI_BCM4358)
&cfg_wlanen_pinctrl {
		cfg_wlanen: cfg-wlanen {
			samsung,pins = cfg_wlanen_pin;
			samsung,pin-function = <cfg_wlanen_con>;
			samsung,pin-drv = <cfg_wlanen_drv>;
			samsung,pin-con-pdn = <cfg_wlanen_con_pdn>;
		};
};

&cfg_wlanhostwake_pinctrl {		
		cfg_wlanhostwake: cfg-wlanhostwake {
			samsung,pins = cfg_wlanhostwake_pin;
			samsung,pin-function = <cfg_wlanhostwake_con>;
			samsung,pin-pud = <cfg_wlanhostwake_pull>;
		};
};
#endif

&dwc3_b_sess_pinctrl {		
		dwc3_b_sess: dwc3-b-sess {
			samsung,pins = dwc3_b_sess_pin;
			samsung,pin-function = <dwc3_b_sess_con>;
			samsung,pin-pud = <dwc3_b_sess_pull>;
		};
};

&dwc3_id_pinctrl {		
		dwc3_id: dwc3-id {
			samsung,pins = dwc3_id_pin;
			samsung,pin-function = <dwc3_id_con>;
			samsung,pin-pud = <dwc3_id_pull>;
		};
};

&pmic_irq_pinctrl {
		pmic_irq: pmic-irq {
			samsung,pins = pmic_irq_pin;
			samsung,pin-pud = <pmic_irq_pull>;
			samsung,pin-drv = <pmic_irq_drv>;
		};
};

&sub_pmic_irq_pinctrl {
		sub_pmic_irq: sub_pmic-irq {
			samsung,pins = sub_pmic_irq_pin;
			samsung,pin-pud = <sub_pmic_irq_pull>;
			samsung,pin-drv = <sub_pmic_irq_drv>;
		};
};

#ifdef CONFIG_DTS_FINGERPRINT_FPC1020
&fpc_irq_pinctrl {
		fpc_irq: fpc-irq {
			samsung,pins = fpc_irq_pin;
			samsung,pin-function = <fpc_irq_con>;
			samsung,pin-pud = <fpc_irq_pull>;
			samsung,pin-drv = <fpc_irq_drv>;
		};
};
#endif

&gpio_keys_pullup_pinctrl {		
		gpio_keys_pullup: gpio_keys_pullup {
			samsung,pins = gpio_keys_pullup_pin0, gpio_keys_pullup_pin1, gpio_keys_pullup_pin2;
			samsung,pin-function = <gpio_keys_pullup_con>;
			samsung,pin-pud = <gpio_keys_pullup_pull>;
			samsung,pin-drv = <gpio_keys_pullup_drv>;
		};
};		

#ifdef CONFIG_DTS_TOUCHSCREEN_SYNAPTICS_DSX
&attn_irq_pinctrl {
		attn_irq: attn-irq {
			samsung,pins = attn_irq_pin;
			samsung,pin-function = <attn_irq_con>;
			samsung,pin-pud = <attn_irq_pull>;
			samsung,pin-drv = <attn_irq_drv>;
		};
};

&attn_input_pinctrl {		
		attn_input: attn-input {
			samsung,pins = attn_input_pin;
			samsung,pin-function = <attn_input_con>;
			samsung,pin-pud = <attn_input_pull>;
			samsung,pin-drv = <attn_input_drv>;
		};
};
#endif

#ifdef CONFIG_DTS_TOUCHSCREEN_FTS
&touchpanel_fts_irq_pinctrl {		
		touchpanel_fts_irq: touchpanel-fts-irq {
			samsung,pins = touchpanel_fts_irq_pin;
			samsung,pin-function = <touchpanel_fts_irq_con>;
			samsung,pin-pud = <touchpanel_fts_irq_pull>;
			samsung,pin-drv = <touchpanel_fts_irq_drv>;
		};
};		
#endif

#if defined(CONFIG_DTS_TOUCHSCREEN_ATMEL_MXTS)||defined(CONFIG_DTS_TOUCHSCREEN_MELFAS)
&touchpanel_irq_pinctrl {		
		touchpanel_irq: touchpanel-irq {
			samsung,pins = touchpanel_irq_pin;
			samsung,pin-function = <touchpanel_irq_con>;
			samsung,pin-pud = <touchpanel_irq_pull>;
			samsung,pin-drv = <touchpanel_irq_drv>;
		};
};

&touchpanel_input_pinctrl {		
		touchpanel_input: touchpanel-input {
			samsung,pins = touchpanel_input_pin;
			samsung,pin-function = <touchpanel_input_con>;
			samsung,pin-pud = <touchpanel_input_pull>;
			samsung,pin-drv = <touchpanel_input_drv>;
		};
};
#endif

#ifdef CONFIG_DTS_TSU6721_MUIC
&muic_int_pinctrl {
		muic_int: muic-int {
			samsung,pins = muic_int_pin;
			samsung,pin-function = <muic_int_con>;
			samsung,pin-pud = <muic_int_pull>;
			samsung,pin-drv = <muic_int_drv>;
		};
};
#endif	

#ifdef CONFIG_DTS_CHARGER_BQ24297
&chg_irq_pinctrl {		
		chg_irq: chg-irq {
			samsung,pins = chg_irq_pin;
			samsung,pin-function = <chg_irq_con>;
			samsung,pin-pud = <chg_irq_pull>;
			samsung,pin-drv = <chg_irq_drv>;
		};
};
#endif		


#ifdef CONFIG_DTS_CHARGER_BQ24195
&chg_irq_pinctrl {		
		chg_irq: chg-irq {
			samsung,pins = chg_irq_pin;
			samsung,pin-function = <chg_irq_con>;
			samsung,pin-pud = <chg_irq_pull>;
			samsung,pin-drv = <chg_irq_drv>;
		};
};
#endif		

#ifdef CONFIG_DTS_BATTERY_BQ27425	
&bat_alrt_pinctrl {		
		bat_alrt: fuel-int {
			samsung,pins = bat_alrt_pin;
			samsung,pin-function = <bat_alrt_con>;
			samsung,pin-pud = <bat_alrt_pull>;
			samsung,pin-drv = <bat_alrt_drv>;
		};
};		
#endif


#ifdef CONFIG_DTS_BATTERY_CW2015	
&bat_alrt_pinctrl {		
		bat_alrt: fuel-int {
			samsung,pins = bat_alrt_pin;
			samsung,pin-function = <bat_alrt_con>;
			samsung,pin-pud = <bat_alrt_pull>;
			samsung,pin-drv = <bat_alrt_drv>;
		};
};		
#endif

#ifdef CONFIG_DTS_SENSOR_TMD2771X
&lp_irq_pinctrl {
		lp_irq: lp-irq {
			samsung,pins = lp_irq_pin;
			samsung,pin-function = <lp_irq_con>;
			samsung,pin-pud = <lp_irq_pull>;
			samsung,pin-drv = <lp_irq_drv>;
		};
};
#endif

#ifdef CONFIG_DTS_SENSOR_MPU6500
&gyro_irq_pinctrl {
		gyro_irq: gyro-irq {
			samsung,pins = gyro_irq_pin;
			samsung,pin-function = <gyro_irq_con>;
			samsung,pin-pud = <gyro_irq_pull>;
			samsung,pin-drv = <gyro_irq_drv>;
		};
};
#endif

#ifdef CONFIG_DTS_AUDIOCODEC_RT5647
&codec_irq_pinctrl {		
		codec_irq: codec-irq {
			samsung,pins = codec_irq_pin;
			samsung,pin-function = <codec_irq_con>;
			samsung,pin-pud = <codec_irq_pull>;
		};
};

&codec_irq_idle_pinctrl {		
		codec_irq_idle: codec-irq-idle {
			samsung,pins = codec_irq_idle_pin;
			samsung,pin-function = <codec_irq_idle_con>;
			samsung,pin-pud = <codec_irq_idle_pull>;
		};
};

&codec_reset_pinctrl {
		codec_reset: codec-reset {
			samsung,pins = codec_reset_pin;
			samsung,pin-function = <codec_reset_con>;
			samsung,pin-pud = <codec_reset_pull>;
			samsung,pin-con-pdn = <codec_reset_con_pdn>;
			samsung,pin-pud-pdn = <codec_reset_pull_pdn>;
			samsung,pin-val = <codec_reset_val>;
		};
};

&codec_ldoena_pinctrl {		
		codec_ldoena: codec-ldoena {
			samsung,pins =codec_ldoena_pin;
			samsung,pin-function = <codec_ldoena_con>;
			samsung,pin-pud = <codec_ldoena_pull>;
			samsung,pin-con-pdn = <codec_ldoena_con_pdn>;
			samsung,pin-pud-pdn = <codec_ldoena_pull_pdn>;
			samsung,pin-val = <codec_ldoena_val>;
		};
};

&rt5647_i2s_bus_sd0_pinctrl {
		rt5647_i2s_bus_sd0: rt5647-i2s-bus_sd0 {
			samsung,pins = rt5647_i2s_bus_sd0_pin0, rt5647_i2s_bus_sd0_pin1, rt5647_i2s_bus_sd0_pin2, rt5647_i2s_bus_sd0_pin3,
					rt5647_i2s_bus_sd0_pin4;
			samsung,pin-function = <rt5647_i2s_bus_sd0_con>;
			samsung,pin-pud = <rt5647_i2s_bus_sd0_pull>;
			samsung,pin-drv = <rt5647_i2s_bus_sd0_drv>;
		};
};
		
&rt5647_i2s_bus_idle_sd0_pinctrl {
		rt5647_i2s_bus_idle_sd0: rt5647-i2s-bus-idle_sd0 {
			samsung,pins = rt5647_i2s_bus_idle_sd0_pin0, rt5647_i2s_bus_idle_sd0_pin1, rt5647_i2s_bus_idle_sd0_pin2, rt5647_i2s_bus_idle_sd0_pin3,
					rt5647_i2s_bus_idle_sd0_pin4;
			samsung,pin-function = <rt5647_i2s_bus_idle_sd0_con>;
			samsung,pin-pud = <rt5647_i2s_bus_idle_sd0_pull>;
			samsung,pin-drv = <rt5647_i2s_bus_idle_sd0_drv>;
		};
};
#endif

#ifdef CONFIG_DTS_AUDIOCODEC_WM5110
&codec_irq_pinctrl {		
		codec_irq: codec-irq {
			samsung,pins = codec_irq_pin;
			samsung,pin-function = <codec_irq_con>;
			samsung,pin-pud = <codec_irq_pull>;
		};
};

&codec_irq_idle_pinctrl {		
		codec_irq_idle: codec-irq-idle {
			samsung,pins = codec_irq_idle_pin;
			samsung,pin-function = <codec_irq_idle_con>;
			samsung,pin-pud = <codec_irq_idle_pull>;
		};
};

&codec_reset_pinctrl {
		codec_reset: codec-reset {
			samsung,pins = codec_reset_pin;
			samsung,pin-function = <codec_reset_con>;
			samsung,pin-pud = <codec_reset_pull>;
			samsung,pin-con-pdn = <codec_reset_con_pdn>;
			samsung,pin-pud-pdn = <codec_reset_pull_pdn>;
			samsung,pin-val = <codec_reset_val>;
		};
};

&codec_ldoena_pinctrl {		
		codec_ldoena: codec-ldoena {
			samsung,pins =codec_ldoena_pin;
			samsung,pin-function = <codec_ldoena_con>;
			samsung,pin-pud = <codec_ldoena_pull>;
			samsung,pin-con-pdn = <codec_ldoena_con_pdn>;
			samsung,pin-pud-pdn = <codec_ldoena_pull_pdn>;
			samsung,pin-val = <codec_ldoena_val>;
		};
};

&wm5110_i2s_bus_sd0_pinctrl {
		wm5110_i2s_bus_sd0: wm5110-i2s-bus_sd0 {
			samsung,pins = wm5110_i2s_bus_sd0_pin0, wm5110_i2s_bus_sd0_pin2, wm5110_i2s_bus_sd0_pin3,
					wm5110_i2s_bus_sd0_pin4;
			samsung,pin-function = <wm5110_i2s_bus_sd0_con>;
			samsung,pin-pud = <wm5110_i2s_bus_sd0_pull>;
			samsung,pin-drv = <wm5110_i2s_bus_sd0_drv>;
		};
};
		
&wm5110_i2s_bus_idle_sd0_pinctrl {
		wm5110_i2s_bus_idle_sd0: wm5110-i2s-bus-idle_sd0 {
			samsung,pins = wm5110_i2s_bus_idle_sd0_pin0, wm5110_i2s_bus_idle_sd0_pin2, wm5110_i2s_bus_idle_sd0_pin3,
					wm5110_i2s_bus_idle_sd0_pin4;
			samsung,pin-function = <wm5110_i2s_bus_idle_sd0_con>;
			samsung,pin-pud = <wm5110_i2s_bus_idle_sd0_pull>;
			samsung,pin-drv = <wm5110_i2s_bus_idle_sd0_drv>;
		};
};
#endif

&i2s0_bus_pinctrl {
		i2s0_bus: i2s0-bus {
			samsung,pins = i2s0_bus_pin0, i2s0_bus_pin1, i2s0_bus_pin2, i2s0_bus_pin3,
					i2s0_bus_pin4, i2s0_bus_pin5, i2s0_bus_pin6;
			samsung,pin-function = <i2s0_bus_con>;
			samsung,pin-pud = <i2s0_bus_pull>;
			samsung,pin-drv = <i2s0_bus_drv>;
		};
};

&i2s0_bus_idle_pinctrl {
		i2s0_bus_idle: i2s0-bus-idle {
			samsung,pins = i2s0_bus_idle_pin0, i2s0_bus_idle_pin1, i2s0_bus_idle_pin2, i2s0_bus_idle_pin3,
					i2s0_bus_idle_pin4, i2s0_bus_idle_pin5, i2s0_bus_idle_pin6;
			samsung,pin-function = <i2s0_bus_idle_con>;
			samsung,pin-pud = <i2s0_bus_idle_pull>;
			samsung,pin-drv = <i2s0_bus_idle_drv>;
		};
};		

&pcm0_bus_pinctrl {
		pcm0_bus: pcm0-bus {
			samsung,pins = pcm0_bus_pin0, pcm0_bus_pin1, pcm0_bus_pin2, pcm0_bus_pin3;
			samsung,pin-function = <pcm0_bus_con>;
			samsung,pin-pud = <pcm0_bus_pull>;
			samsung,pin-drv = <pcm0_bus_drv>;
		};
};

&uart_aud_bus_pinctrl {
		uart_aud_bus: uart-aud-bus {
			samsung,pins = uart_aud_bus_pin0, uart_aud_bus_pin1, uart_aud_bus_pin2, uart_aud_bus_pin3;
			samsung,pin-function = <uart_aud_bus_con>;
			samsung,pin-pud = <uart_aud_bus_pull>;
			samsung,pin-con-pdn=<uart_aud_bus_con_pdn>;
			samsung,pin-pud-pdn=<uart_aud_bus_pull_pdn>;
		};
};

&uart_aud_bus_idle_pinctrl {
		uart_aud_bus_idle: uart-aud-bus-idle {
			   samsung,pins = uart_aud_bus_idle_pin;
			   samsung,pin-function = <uart_aud_bus_idle_con>;
			   samsung,pin-val = <uart_aud_bus_idle_val>;
			   samsung,pin-pud = <uart_aud_bus_idle_pull>;
			   samsung,pin-con-pdn = <uart_aud_bus_idle_con_pdn>;
			   samsung,pin-pud-pdn = <uart_aud_bus_idle_pud_pdn>;
		   };
};

&uart_aud_bus_lpm_pinctrl {
		uart_aud_bus_lpm: uart-aud-bus-lpm {
			  samsung,pins = uart_aud_bus_lpm_pin;
			  samsung,pin-function = <uart_aud_bus_lpm_con>;
			  samsung,pin-val = <uart_aud_bus_lpm_val>;
			  samsung,pin-pud = <uart_aud_bus_lpm_pull>;
			  samsung,pin-con-pdn = <uart_aud_bus_lpm_con_pdn>;
			  samsung,pin-pud-pdn = <uart_aud_bus_lpm_pull_pdn>;
		  };
};


&uart_bt_active_pinctrl {
		uart_bt_active: uart-bt-active {
			samsung,pins = uart_bt_active_pin0, uart_bt_active_pin1, uart_bt_active_pin2, uart_bt_active_pin3;
			samsung,pin-function = <uart_bt_active_con>;
			samsung,pin-pud = <uart_bt_active_pull>;
		};
};

&uart_bt_output_sleep_pinctrl {
		uart_bt_output_sleep: uart-bt-output-sleep {
			samsung,pins = uart_bt_output_sleep_pin0, uart_bt_output_sleep_pin3;
			samsung,pin-con-pdn = <uart_bt_output_sleep_con_pdn>;
			samsung,pin-pud-pdn = <uart_bt_output_sleep_pull_pdn>;
		};
};

&uart_bt_input_sleep_pinctrl {
		uart_bt_input_sleep: uart-bt-input-sleep {
			samsung,pins = uart_bt_input_sleep_pin1, uart_bt_input_sleep_pin2;
			samsung,pin-con-pdn = <uart_bt_input_sleep_con_pdn>;
			samsung,pin-pud-pdn = <uart_bt_input_sleep_pull_pdn>;
		};
};

&dbg_if_pinctrl {		
		dbg_if: dbg-if {
			samsung,pins = dbg_if_pin;
			samsung,pin-function = <dbg_if_con>;
			samsung,pin-pud = <dbg_if_pull>;
			samsung,pin-drv = <dbg_if_drv>;
			samsung,pin-con-pdn = <dbg_if_con_pdn>;
			samsung,pin-pud-pdn = <dbg_if_pull_pdn>;
			samsung,pin-val = <dbg_if_val>;
		};
};

&hs_i2c0_bus_pinctrl {
		hs_i2c0_bus: hs-i2c0-bus {
			samsung,pins = hs_i2c0_bus_pin0, hs_i2c0_bus_pin1;
			samsung,pin-function = <hs_i2c0_bus_con>;
			samsung,pin-pud = <hs_i2c0_bus_pull>;
			samsung,pin-drv = <hs_i2c0_bus_drv>;
		};
};

&hs_i2c1_bus_pinctrl {
		hs_i2c1_bus: hs-i2c1-bus {
			samsung,pins = hs_i2c1_bus_pin0, hs_i2c1_bus_pin1;
			samsung,pin-function = <hs_i2c1_bus_con>;
			samsung,pin-pud = <hs_i2c1_bus_pull>;
			samsung,pin-drv = <hs_i2c1_bus_drv>;
		};
};

&hs_i2c2_bus_pinctrl {
		hs_i2c2_bus: hs-i2c2-bus {
			samsung,pins = hs_i2c2_bus_pin0, hs_i2c2_bus_pin1;
			samsung,pin-function = <hs_i2c2_bus_con>;
			samsung,pin-pud = <hs_i2c2_bus_pull>;
			samsung,pin-drv = <hs_i2c2_bus_drv>;
		};
};

&hs_i2c3_bus_pinctrl {
		hs_i2c3_bus: hs-i2c3-bus {
			samsung,pins = hs_i2c3_bus_pin0, hs_i2c3_bus_pin1;
			samsung,pin-function = <hs_i2c3_bus_con>;
			samsung,pin-pud = <hs_i2c3_bus_pull>;
			samsung,pin-drv = <hs_i2c3_bus_drv>;
		};
};

&hs_i2c4_bus_pinctrl {
		hs_i2c4_bus: hs-i2c4-bus {
			samsung,pins = hs_i2c4_bus_pin0, hs_i2c4_bus_pin1;
			samsung,pin-function = <hs_i2c4_bus_con>;
			samsung,pin-pud = <hs_i2c4_bus_pull>;
			samsung,pin-drv = <hs_i2c4_bus_drv>;
		};
};

&hs_i2c4_apm_pinctrl {
		hs_i2c4_apm: hs-i2c4-apm {
			samsung,pins = hs_i2c4_apm_pin0, hs_i2c4_apm_pin1;
			samsung,pin-function = <hs_i2c4_apm_con>;
			samsung,pin-pud = <hs_i2c4_apm_pull>;
			samsung,pin-drv = <hs_i2c4_apm_drv>;
		};
};

&hs_i2c5_bus_pinctrl {
		hs_i2c5_bus: hs-i2c5-bus {
			samsung,pins = hs_i2c5_bus_pin0, hs_i2c5_bus_pin1;
			samsung,pin-function = <hs_i2c5_bus_con>;
			samsung,pin-pud = <hs_i2c5_bus_pull>;
			samsung,pin-drv = <hs_i2c5_bus_drv>;
		};
};

&hs_i2c6_bus_pinctrl {
		hs_i2c6_bus: hs-i2c6-bus {
			samsung,pins = hs_i2c6_bus_pin0, hs_i2c6_bus_pin1;
			samsung,pin-function = <hs_i2c6_bus_con>;
			samsung,pin-pud = <hs_i2c6_bus_pull>;
			samsung,pin-drv = <hs_i2c6_bus_drv>;
		};
};

&hs_i2c7_bus_pinctrl {
		hs_i2c7_bus: hs-i2c7-bus {
			samsung,pins = hs_i2c7_bus_pin0, hs_i2c7_bus_pin1;
			samsung,pin-function = <hs_i2c7_bus_con>;
			samsung,pin-pud = <hs_i2c7_bus_pull>;
			samsung,pin-drv = <hs_i2c7_bus_drv>;
		};
};

&hs_i2c8_bus_pinctrl {
		hs_i2c8_bus: hs-i2c8-bus {
			samsung,pins = hs_i2c8_bus_pin0, hs_i2c8_bus_pin1;
			samsung,pin-function = <hs_i2c8_bus_con>;
			samsung,pin-pud = <hs_i2c8_bus_pull>;
			samsung,pin-drv = <hs_i2c8_bus_drv>;
		};
};

&hs_i2c9_bus_pinctrl {
		hs_i2c9_bus: hs-i2c9-bus {
			samsung,pins = hs_i2c9_bus_pin0, hs_i2c9_bus_pin1;
			samsung,pin-function = <hs_i2c9_bus_con>;
			samsung,pin-pud = <hs_i2c9_bus_pull>;
			samsung,pin-drv = <hs_i2c9_bus_drv>;
		};
};

&hs_i2c10_bus_pinctrl {
		hs_i2c10_bus: hs-i2c10-bus {
			samsung,pins = hs_i2c10_bus_pin0, hs_i2c10_bus_pin1;
			samsung,pin-function = <hs_i2c10_bus_con>;
			samsung,pin-pud = <hs_i2c10_bus_pull>;
			samsung,pin-drv = <hs_i2c10_bus_drv>;
		};
};

&hs_i2c11_bus_pinctrl {
		hs_i2c11_bus: hs-i2c11-bus {
			samsung,pins = hs_i2c11_bus_pin0, hs_i2c11_bus_pin1;
			samsung,pin-function = <hs_i2c11_bus_con>;
			samsung,pin-pud = <hs_i2c11_bus_pull>;
			samsung,pin-drv = <hs_i2c11_bus_drv>;
		};
};

&uart_isp_bus_pinctrl {
		uart_isp_bus: uart-isp-bus {
			samsung,pins = uart_isp_bus_pin0, uart_isp_bus_pin1, uart_isp_bus_pin2, uart_isp_bus_pin3;
			samsung,pin-function = <uart_isp_bus_con>;
			samsung,pin-pud = <uart_isp_bus_pull>;
		};
};

&uart0_bus_pinctrl {
		uart0_bus: uart0-bus {
			//samsung,pins = uart0_bus_pin0, uart0_bus_pin1, uart0_bus_pin2, uart0_bus_pin3;
			samsung,pins = uart0_bus_pin0, uart0_bus_pin1; //only tx, rx
			samsung,pin-function = <uart0_bus_con>;
			samsung,pin-pud = <uart0_bus_pull>;
		};
};

&uart1_bus_pinctrl {
		uart1_bus: uart1-bus {
			//samsung,pins = uart1_bus_pin0, uart1_bus_pin1, uart1_bus_pin2, uart1_bus_pin3;
			samsung,pins = uart1_bus_pin0, uart1_bus_pin1;// only tx, rx
			samsung,pin-function = <uart1_bus_con>;
			samsung,pin-pud = <uart1_bus_pull>;
		};
};

&uart2_bus_pinctrl {
		uart2_bus: uart2-bus {
			samsung,pins = uart2_bus_pin0, uart2_bus_pin1;
			samsung,pin-function = <uart2_bus_con>;
			samsung,pin-pud = <uart2_bus_pull>;
		};
};

&uart3_bus_pinctrl {
		uart3_bus: uart3-bus {
			samsung,pins = uart3_bus_pin0, uart3_bus_pin1;
			samsung,pin-function = <uart3_bus_con>;
			samsung,pin-pud = <uart3_bus_pull>;
		};
};

&spi0_bus_pinctrl {
		spi0_bus: spi0-bus {
			samsung,pins = spi0_bus_pin0, spi0_bus_pin1, spi0_bus_pin2;
			samsung,pin-function = <spi0_bus_con>;
			samsung,pin-pud = <spi0_bus_pull>;
			samsung,pin-drv = <spi0_bus_drv>;
		};
};

&spi0_cs_func_pinctrl {
		spi0_cs_func: spi0-cs-func {
			samsung,pins = spi0_cs_func_pin;
			samsung,pin-function = <spi0_cs_func_con>;
			samsung,pin-pud = <spi0_cs_func_pull>;
			samsung,pin-drv = <spi0_cs_func_drv>;
		};
};

&spi0_cs_pinctrl {
		spi0_cs: spi0-cs {
			samsung,pins = spi0_cs_pin;
			samsung,pin-function = <spi0_cs_con>;
			samsung,pin-pud = <spi0_cs_pull>;
			samsung,pin-drv = <spi0_cs_drv>;
		};
};

&spi1_bus_pinctrl {
		spi1_bus: spi1-bus {
			samsung,pins = spi1_bus_pin0, spi1_bus_pin1, spi1_bus_pin2;
			samsung,pin-function = <spi1_bus_con>;
			samsung,pin-pud = <spi1_bus_pull>;
			samsung,pin-drv = <spi1_bus_drv>;
		};
};

&spi1_cs_func_pinctrl {
		spi1_cs_func: spi1-cs-func {
			samsung,pins = spi1_cs_func_pin;
			samsung,pin-function = <spi1_cs_func_con>;
			samsung,pin-pud = <spi1_cs_func_pull>;
			samsung,pin-drv = <spi1_cs_func_drv>;
		};
};

&spi1_cs_pinctrl {
		spi1_cs: spi1-cs {
			samsung,pins = spi1_cs_pin;
			samsung,pin-function = <spi1_cs_con>;
			samsung,pin-pud = <spi1_cs_pull>;
			samsung,pin-drv = <spi1_cs_drv>;
		};
};

&spi2_bus_pinctrl {
		spi2_bus: spi2-bus {
			samsung,pins = spi2_bus_pin0, spi2_bus_pin1, spi2_bus_pin2;
			samsung,pin-function = <spi2_bus_con>;
			samsung,pin-pud = <spi2_bus_pull>;
			samsung,pin-drv = <spi2_bus_drv>;
		};
};

&spi2_cs_func_pinctrl {
		spi2_cs_func: spi2-cs-func {
			samsung,pins = spi2_cs_func_pin;
			samsung,pin-function = <spi2_cs_func_con>;
			samsung,pin-pud = <spi2_cs_func_pull>;
			samsung,pin-drv = <spi2_cs_func_drv>;
		};
};

&spi2_cs_pinctrl {
		spi2_cs: spi2-cs {
			samsung,pins = spi2_cs_pin;
			samsung,pin-function = <spi2_cs_con>;
			samsung,pin-pud = <spi2_cs_pull>;
			samsung,pin-drv = <spi2_cs_drv>;
		};
};

&disp_teson_pinctrl {
		disp_teson: disp_teson {
			samsung,pins = disp_teson_pin;
			samsung,pin-function = <disp_teson_con>;
		};
};

&disp_tesoff_pinctrl {
		disp_tesoff: disp_tesoff {
			samsung,pins = disp_tesoff_pin;
			samsung,pin-function = <disp_tesoff_con>;
		};
};

&disp1_teson_pinctrl {
		disp1_teson: disp1_teson {
			samsung,pins = disp1_teson_pin;
			samsung,pin-function = <disp1_teson_con>;
		};
};

&disp1_tesoff_pinctrl {
		disp1_tesoff: disp1_tesoff {
			samsung,pins = disp1_tesoff_pin;
			samsung,pin-function = <disp1_tesoff_con>;
		};
};


&fimc_is_uart_pinctrl {
		fimc_is_uart: fimc-is-uart {
			samsung,pins = fimc_is_uart_pin0, fimc_is_uart_pin1;
			samsung,pin-function = <fimc_is_uart_con>;
			samsung,pin-pud = <fimc_is_uart_pull>;
			samsung,pin-drv = <fimc_is_uart_drv>;
		};
};

&fimc_is_mclk0_in_pinctrl {
		fimc_is_mclk0_in: fimc_is_mclk0_in {
			samsung,pins = fimc_is_mclk0_in_pin;
			samsung,pin-function = <fimc_is_mclk0_in_con>;
			samsung,pin-pud = <fimc_is_mclk0_in_pull>;
			samsung,pin-drv = <fimc_is_mclk0_in_drv>;
		};
};

&fimc_is_mclk1_in_pinctrl {
		fimc_is_mclk1_in: fimc_is_mclk1_in {
			samsung,pins = fimc_is_mclk1_in_pin;
			samsung,pin-function = <fimc_is_mclk1_in_con>;
			samsung,pin-pud = <fimc_is_mclk1_in_pull>;
			samsung,pin-drv = <fimc_is_mclk1_in_drv>;
		};
};

&fimc_is_mclk2_in_pinctrl {
		fimc_is_mclk2_in: fimc_is_mclk2_in {
			samsung,pins = fimc_is_mclk2_in_pin;
			samsung,pin-function = <fimc_is_mclk2_in_con>;
			samsung,pin-pud = <fimc_is_mclk2_in_pull>;
			samsung,pin-drv = <fimc_is_mclk2_in_drv>;
		};
};

&fimc_is_mclk0_out_pinctrl {
		fimc_is_mclk0_out: fimc_is_mclk0_out {
			samsung,pins = fimc_is_mclk0_out_pin;
			samsung,pin-function = <fimc_is_mclk0_out_con>;
			samsung,pin-pud = <fimc_is_mclk0_out_pull>;
			samsung,pin-drv = <fimc_is_mclk0_out_drv>;
		};
};

&fimc_is_mclk1_out_pinctrl {
		fimc_is_mclk1_out: fimc_is_mclk1_out {
			samsung,pins = fimc_is_mclk1_out_pin;
			samsung,pin-function = <fimc_is_mclk1_out_con>;
			samsung,pin-pud = <fimc_is_mclk1_out_pull>;
			samsung,pin-drv = <fimc_is_mclk1_out_drv>;
		};
};

&fimc_is_mclk2_out_pinctrl {
		fimc_is_mclk2_out: fimc_is_mclk2_out {
			samsung,pins = fimc_is_mclk2_out_pin;
			samsung,pin-function = <fimc_is_mclk2_out_con>;
			samsung,pin-pud = <fimc_is_mclk2_out_pull>;
			samsung,pin-drv = <fimc_is_mclk2_out_drv>;
		};
};

&fimc_is_mclk0_fn_pinctrl {
		fimc_is_mclk0_fn: fimc_is_mclk0_fn {
			samsung,pins = fimc_is_mclk0_fn_pin;
			samsung,pin-function = <fimc_is_mclk0_fn_con>;
			samsung,pin-pud = <fimc_is_mclk0_fn_pull>;
			samsung,pin-drv = <fimc_is_mclk0_fn_drv>;
		};
};

&fimc_is_mclk1_fn_pinctrl {
		fimc_is_mclk1_fn: fimc_is_mclk1_fn {
			samsung,pins = fimc_is_mclk1_fn_pin;
			samsung,pin-function = <fimc_is_mclk1_fn_con>;
			samsung,pin-pud = <fimc_is_mclk1_fn_pull>;
			samsung,pin-drv = <fimc_is_mclk1_fn_drv>;
		};
};

&fimc_is_mclk2_fn_pinctrl {
		fimc_is_mclk2_fn: fimc_is_mclk2_fn {
			samsung,pins = fimc_is_mclk2_fn_pin;
			samsung,pin-function = <fimc_is_mclk2_fn_con>;
			samsung,pin-pud = <fimc_is_mclk2_fn_pull>;
			samsung,pin-drv = <fimc_is_mclk2_fn_drv>;
		};
};

&fimc_is_i2c0_pinctrl {
		fimc_is_i2c0: fimc_is_i2c0 {
			samsung,pins = fimc_is_i2c0_pin0, fimc_is_i2c0_pin1;
			samsung,pin-function = <fimc_is_i2c0_con>;
			samsung,pin-pud = <fimc_is_i2c0_pull>;
			samsung,pin-drv = <fimc_is_i2c0_drv>;
		};
};

&fimc_is_i2c1_pinctrl {
		fimc_is_i2c1: fimc_is_i2c1 {
			samsung,pins = fimc_is_i2c1_pin0, fimc_is_i2c1_pin1;
			samsung,pin-function = <fimc_is_i2c1_con>;
			samsung,pin-pud = <fimc_is_i2c1_pull>;
			samsung,pin-drv = <fimc_is_i2c1_drv>;
		};
};

&fimc_is_i2c2_pinctrl {
		fimc_is_i2c2: fimc_is_i2c2 {
			samsung,pins = fimc_is_i2c2_pin0, fimc_is_i2c2_pin1;
			samsung,pin-function = <fimc_is_i2c2_con>;
			samsung,pin-pud = <fimc_is_i2c2_pull>;
			samsung,pin-drv = <fimc_is_i2c2_drv>;
		};
};

&fimc_is_vision_pinctrl {
		fimc_is_vision: fimc_is_vision {
			samsung,pins = fimc_is_vision_pin0, fimc_is_vision_pin1;
			samsung,pin-function = <fimc_is_vision_con>;
			samsung,pin-pud = <fimc_is_vision_pull>;
			samsung,pin-drv = <fimc_is_vision_drv>;
		};
};

&fimc_is_flash_pinctrl {
		fimc_is_flash: fimc-is-flash {
			samsung,pins = fimc_is_flash_pin0, fimc_is_flash_pin1;
			samsung,pin-function = <fimc_is_flash_con>;
			samsung,pin-pud = <fimc_is_flash_pull>;
			samsung,pin-drv = <fimc_is_flash_drv>;
		};
};

&fimc_is_spi_pin0_pinctrl {
		fimc_is_spi_pin0: fimc-is-spi-pin0 {
			samsung,pins = fimc_is_spi_pin0_pin0, fimc_is_spi_pin0_pin1, fimc_is_spi_pin0_pin2;
			samsung,pin-function = <fimc_is_spi_pin0_con>;
			samsung,pin-pud = <fimc_is_spi_pin0_pull>;
			samsung,pin-drv = <fimc_is_spi_pin0_drv>;
		};
};

&fimc_is_spi_pin1_pinctrl {
		fimc_is_spi_pin1: fimc-is-spi-pin1 {
			samsung,pins = fimc_is_spi_pin1_pin0, fimc_is_spi_pin1_pin1, fimc_is_spi_pin1_pin2;
			samsung,pin-function = <fimc_is_spi_pin1_con>;
			samsung,pin-pud = <fimc_is_spi_pin1_pull>;
			samsung,pin-drv = <fimc_is_spi_pin1_drv>;
		};
};

&i2s1_bus_pinctrl {
		i2s1_bus: i2s1-bus {
			samsung,pins = i2s1_bus_pin0, i2s1_bus_pin1, i2s1_bus_pin2,
					i2s1_bus_pin3, i2s1_bus_pin4;
			samsung,pin-function = <i2s1_bus_con>;
			samsung,pin-pud = <i2s1_bus_pull>;
			samsung,pin-drv = <i2s1_bus_drv>;
		};
};

&pcm1_bus_pinctrl {
		pcm1_bus: pcm1-bus {
			samsung,pins = pcm1_bus_pin0, pcm1_bus_pin1, pcm1_bus_pin2,
					pcm1_bus_pin3, pcm1_bus_pin4;
			samsung,pin-function = <pcm1_bus_con>;
			samsung,pin-pud = <pcm1_bus_pull>;
			samsung,pin-drv = <pcm1_bus_drv>;
		};
};
		
&spdif_bus_pinctrl {
		spdif_bus: spdif-bus {
			samsung,pins = spdif_bus_pin0, spdif_bus_pin1;
			samsung,pin-function = <spdif_bus_con>;
			samsung,pin-pud = <spdif_bus_pull>;
			samsung,pin-drv = <spdif_bus_drv>;
		};
};

#ifdef CONFIG_DTS_WIFI_BCM4358
&wifi_pcie_clkreq_pinctrl {
		wifi_pcie_clkreq: wifi_pcie_clkreq {
			samsung,pins = wifi_pcie_clkreq_pin;
			samsung,pin-function = <wifi_pcie_clkreq_con>;
			samsung,pin-pud = <wifi_pcie_clkreq_pull>;
			samsung,pin-drv = <wifi_pcie_clkreq_drv>;
			samsung,pin-con-pdn = <wifi_pcie_clkreq_con_pdn>;
			samsung,pin-pud-pdn = <wifi_pcie_clkreq_pull_pdn>;
		};
};

&wifi_pcie_perst_pinctrl {
		wifi_pcie_perst: wifi_pcie_perst {
			samsung,pins = wifi_pcie_perst_pin;
			samsung,pin-function = <wifi_pcie_perst_con>;
			samsung,pin-drv = <wifi_pcie_perst_drv>;
			samsung,pin-con-pdn = <wifi_pcie_perst_con_pdn>;
		};
};

&wifi_pcie_reset_pinctrl {
		wifi_pcie_reset: wifi_pcie_link_reset {
			samsung,pins = wifi_pcie_reset_pin;
			samsung,pin-function = <wifi_pcie_reset_con>;
			samsung,pin-pud = <wifi_pcie_reset_pull>;
			samsung,pin-con-pdn = <wifi_pcie_reset_con_pdn>;
			samsung,pin-pud-pdn = <wifi_pcie_reset_pull_pdn>;
		};
};

&wifi_pcie_reset_clear_pinctrl {
		wifi_pcie_reset_clear: wifi_pcie_reset_clear {
			samsung,pins = wifi_pcie_reset_clear_pin;
			samsung,pin-function = <wifi_pcie_reset_clear_con>;
			samsung,pin-pud = <wifi_pcie_reset_clear_pull>;
			samsung,pin-con-pdn = <wifi_pcie_reset_clear_con_pdn>;
			samsung,pin-pud-pdn = <wifi_pcie_reset_clear_pull_pdn>;
		};
};
#endif

&spi5_bus_pinctrl {
		spi5_bus: spi5-bus {
			samsung,pins = spi5_bus_pin0, spi5_bus_pin1, spi5_bus_pin2;
			samsung,pin-function = <spi5_bus_con>;
			samsung,pin-pud = <spi5_bus_pull>;
			samsung,pin-drv = <spi5_bus_drv>;
		};
};		

&spi5_cs_func_pinctrl {
		spi5_cs_func: spi5-cs-func {
			samsung,pins = spi5_cs_func_pin;
			samsung,pin-function = <spi5_cs_func_con>;
			samsung,pin-pud = <spi5_cs_func_pull>;
			samsung,pin-drv = <spi5_cs_func_drv>;
		};
};

&spi5_cs_pinctrl {
		spi5_cs: spi5-cs {
			samsung,pins = spi5_cs_pin;
			samsung,pin-function = <spi5_cs_con>;
			samsung,pin-pud = <spi5_cs_pull>;
			samsung,pin-drv = <spi5_cs_drv>;
		};
};

&ufs_refclk_out_pinctrl {
		ufs_refclk_out: ufs-refclk-out {
			samsung,pins = ufs_refclk_out_pin;
			samsung,pin-function = <ufs_refclk_out_con>;
			samsung,pin-pud = <ufs_refclk_out_pull>;
			samsung,pin-drv = <ufs_refclk_out_drv>;
		};
};

&ufs_rst_n_pinctrl {
		ufs_rst_n: ufs-rst-n {
			samsung,pins = ufs_rst_n_pin;
			samsung,pin-function = <ufs_rst_n_con>;
			samsung,pin-pud = <ufs_rst_n_pull>;
			samsung,pin-drv = <ufs_rst_n_drv>;
		};
};

&g3d_dvs_pinctrl {		
		g3d_dvs: g3d-dvs {
      			samsung,pins = g3d_dvs_pin;
      			samsung,pin-function = <g3d_dvs_con>;
    		};
};

&pm_wrsti_pinctrl {		
		/* Warm reset information from AP */
		pm_wrsti: pm-wrsti {
			samsung,pins = pm_wrsti_pin;
			samsung,pin-con-pdn = <pm_wrsti_con>;
		};
};

&cfg_wlanen_modem_pinctrl {
		cfg_wlanen_modem: cfg-wlanen_modem {
			samsung,pins = cfg_wlanen_modem_pin;
			samsung,pin-function = <cfg_wlanen_modem_con>;
			samsung,pin-drv = <cfg_wlanen_modem_drv>;
			samsung,pin-con-pdn = <cfg_wlanen_modem_con_pdn>;
		};
};

&vbus_en_pinctrl {		
		vbus_en: vbus_en {
			samsung,pins = vbus_en_pin;
			samsung,pin-function = <vbus_en_con>;
			samsung,pin-pud = <vbus_en_pull>;
		};
};

&spi3_bus_pinctrl {
		spi3_bus: spi3-bus {
			samsung,pins = spi3_bus_pin0, spi3_bus_pin1, spi3_bus_pin2;
			samsung,pin-function = <spi3_bus_con>;
			samsung,pin-pud = <spi3_bus_pull>;
			samsung,pin-drv = <spi3_bus_drv>;
		};
};

&spi3_cs_func_pinctrl {
		spi3_cs_func: spi3-cs-func {
			samsung,pins = spi3_cs_func_pin;
			samsung,pin-function = <spi3_cs_func_con>;
			samsung,pin-pud = <spi3_cs_func_pull>;
			samsung,pin-drv = <spi3_cs_func_drv>;
		};
};
		
&spi3_cs_pinctrl {
		spi3_cs: spi3-cs {
			samsung,pins = spi3_cs_pin;
			samsung,pin-function = <spi3_cs_con>;
			samsung,pin-pud = <spi3_cs_pull>;
			samsung,pin-drv = <spi3_cs_drv>;
		};
};

&spi4_bus_pinctrl {
    		spi4_bus: spi4-bus {
      			samsung,pins = spi4_bus_pin0, spi4_bus_pin1, spi4_bus_pin2;
      			samsung,pin-function = <spi4_bus_con>;
      			samsung,pin-pud = <spi4_bus_pull>;
      			samsung,pin-drv = <spi4_bus_drv>;
    		};
};
 		
&spi4_cs_func_pinctrl {
    		spi4_cs_func: spi4-cs-func {
      			samsung,pins = spi4_cs_func_pin;
      			samsung,pin-function = <spi4_cs_func_con>;
      			samsung,pin-pud = <spi4_cs_func_pull>;
      			samsung,pin-drv = <spi4_cs_func_drv>;
    		};
};

&spi4_cs_pinctrl {
    		spi4_cs: spi4-cs {
      			samsung,pins = spi4_cs_pin;
      			samsung,pin-function = <spi4_cs_con>;
      			samsung,pin-pud = <spi4_cs_pull>;
      			samsung,pin-drv = <spi4_cs_drv>;
    		};
};

&sd2_clk_pinctrl {
		sd2_clk: sd2-clk {
			samsung,pins = sd2_clk_pin;
			samsung,pin-function = <sd2_clk_con>;
			samsung,pin-pud = <sd2_clk_pull>;
			samsung,pin-drv = <sd2_clk_drv>;
		};
};

&sd2_cmd_pinctrl {
		sd2_cmd: sd2-cmd {
			samsung,pins = sd2_cmd_pin;
			samsung,pin-function = <sd2_cmd_con>;
			samsung,pin-pud = <sd2_cmd_pull>;
			samsung,pin-drv = <sd2_cmd_drv>;
		};
};

&sd2_cd_pinctrl {
		sd2_cd: sd2-cd {
			samsung,pins = sd2_cd_pin;
			samsung,pin-function = <sd2_cd_con>;
			samsung,pin-pud = <sd2_cd_pull>;
			samsung,pin-drv = <sd2_cd_drv>;
		};
};

&sd2_bus1_pinctrl {
		sd2_bus1: sd2-bus-width1 {
			samsung,pins = sd2_bus1_pin;
			samsung,pin-function = <sd2_bus1_con>;
			samsung,pin-pud = <sd2_bus1_pull>;
			samsung,pin-drv = <sd2_bus1_drv>;
		};
};
		
&sd2_bus4_pinctrl {
		sd2_bus4: sd2-bus-width4 {
			samsung,pins = sd2_bus4_pin0, sd2_bus4_pin1, sd2_bus4_pin2;
			samsung,pin-function = <sd2_bus4_con>;
			samsung,pin-pud = <sd2_bus4_pull>;
			samsung,pin-drv = <sd2_bus4_drv>;
		};
};

&sd0_clk_pinctrl {
		sd0_clk: sd0-clk {
			samsung,pins = sd0_clk_pin;
			samsung,pin-function = <sd0_clk_con>;
			samsung,pin-pud = <sd0_clk_pull>;
			samsung,pin-drv = <sd0_clk_drv>;
		};
};

&sd0_cmd_pinctrl {
		sd0_cmd: sd0-cmd {
			samsung,pins = sd0_cmd_pin;
			samsung,pin-function = <sd0_cmd_con>;
			samsung,pin-pud = <sd0_cmd_pull>;
			samsung,pin-drv = <sd0_cmd_drv>;
		};
};

&sd0_rdqs_pinctrl {
		sd0_rdqs: sd0-rdqs {
			samsung,pins = sd0_rdqs_pin;
			samsung,pin-function = <sd0_rdqs_con>;
			samsung,pin-pud = <sd0_rdqs_pull>;
			samsung,pin-drv = <sd0_rdqs_drv>;
		};
};

&sd0_qrdy_pinctrl {
		sd0_qrdy: sd0-qrdy {
			samsung,pins = sd0_qrdy_pin;
			samsung,pin-function = <sd0_qrdy_con>;
			samsung,pin-pud = <sd0_qrdy_pull>;
			samsung,pin-drv = <sd0_qrdy_drv>;
		};
};

&sd0_bus1_pinctrl {
		sd0_bus1: sd0-bus-width1 {
			samsung,pins = sd0_bus1_pin;
			samsung,pin-function = <sd0_bus1_con>;
			samsung,pin-pud = <sd0_bus1_pull>;
			samsung,pin-drv = <sd0_bus1_drv>;
		};
};

&sd0_bus4_pinctrl {
		sd0_bus4: sd0-bus-width4 {
			samsung,pins = sd0_bus4_pin0, sd0_bus4_pin1, sd0_bus4_pin2;
			samsung,pin-function = <sd0_bus4_con>;
			samsung,pin-pud = <sd0_bus4_pull>;
			samsung,pin-drv = <sd0_bus4_drv>;
		};
};

&sd0_bus8_pinctrl {
		sd0_bus8: sd0-bus-width8 {
			samsung,pins = sd0_bus8_pin0, sd0_bus8_pin1, sd0_bus8_pin2, sd0_bus8_pin3;
			samsung,pin-function = <sd0_bus8_con>;
			samsung,pin-pud = <sd0_bus8_pull>;
			samsung,pin-drv = <sd0_bus8_drv>;
		};
};

&sd1_clk_pinctrl {
		sd1_clk: sd1-clk {
			samsung,pins = sd1_clk_pin;
			samsung,pin-function = <sd1_clk_con>;
			samsung,pin-pud = <sd1_clk_pull>;
			samsung,pin-drv = <sd1_clk_drv>;
		};
};

&sd1_cmd_pinctrl {
		sd1_cmd: sd1-cmd {
			samsung,pins = sd1_cmd_pin;
			samsung,pin-function = <sd1_cmd_con>;
			samsung,pin-pud = <sd1_cmd_pull>;
			samsung,pin-drv = <sd1_cmd_drv>;
		};
};

&sd1_bus1_pinctrl {
		sd1_bus1: sd1-bus-width1 {
			samsung,pins = sd1_bus1_pin;
			samsung,pin-function = <sd1_bus1_con>;
			samsung,pin-pud = <sd1_bus1_pull>;
			samsung,pin-drv = <sd1_bus1_drv>;
		};
};

&sd1_bus4_pinctrl {
		sd1_bus4: sd1-bus-width4 {
			samsung,pins = sd1_bus4_pin0, sd1_bus4_pin1, sd1_bus4_pin2;
			samsung,pin-function = <sd1_bus4_con>;
			samsung,pin-pud = <sd1_bus4_pull>;
			samsung,pin-drv = <sd1_bus4_drv>;
		};
};

&sd1_bus8_pinctrl {
		sd1_bus8: sd1-bus-width8 {
			samsung,pins = sd1_bus8_pin0, sd1_bus8_pin1, sd1_bus8_pin2, sd1_bus8_pin3;
			samsung,pin-function = <sd1_bus8_con>;
			samsung,pin-pud = <sd1_bus8_pull>;
			samsung,pin-drv = <sd1_bus8_drv>;
		};
};

&pcie_eint_pinctrl {
		pcie_eint: pcie_eint {
			samsung,pins = pcie_eint_pin;
			samsung,pin-function = <pcie_eint_con>;
			samsung,pin-pud = <pcie_eint_pull>;
			samsung,pin-con-pdn = <pcie_eint_con_pdn>;
			samsung,pin-pud-pdn = <pcie_eint_pull_pdn>;
		};
};		

&pcie0_eint_pinctrl {
		pcie0_eint: pcie0_eint {
			samsung,pins = pcie0_eint_pin;
			samsung,pin-function = <pcie0_eint_con>;
			samsung,pin-pud = <pcie0_eint_pull>;
			samsung,pin-con-pdn = <pcie0_eint_con_pdn>;
			samsung,pin-pud-pdn = <pcie0_eint_pull_pdn>;
		};
};

